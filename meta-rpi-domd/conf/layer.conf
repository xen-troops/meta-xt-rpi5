## meta-rpi-domd/conf/layer.conf
```bitbake
# We have a conf and classes directory, append to BBPATH
BBPATH .= ":${LAYERDIR}"

# We have a recipes directory containing .bb and .bbappend files, add to BBFILES
BBFILES += "${LAYERDIR}/recipes*/*/*.bb \
            ${LAYERDIR}/recipes*/*/*.bbappend"

BBFILE_COLLECTIONS += "xt-raspberrypi-domd"
BBFILE_PATTERN_xt-raspberrypi-domd := "^${LAYERDIR}/"
BBFILE_PRIORITY_xt-raspberrypi-domd = "10"

LAYERSERIES_COMPAT_xt-raspberrypi-domd = "kirkstone scarthgap"
LAYERDEPENDS_xt-raspberrypi-domd = "core"

BBFILES_DYNAMIC += " \
    raspberrypi:${LAYERDIR}/dynamic-layers/raspberrypi/*/*/*.bb \
    raspberrypi:${LAYERDIR}/dynamic-layers/raspberrypi/*/*/*.bbappend \
"
```
